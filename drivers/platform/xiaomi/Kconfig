## drivers/platform/xiaomi/Kconfig
```kconfig
# Xiaomi configuration options

config MACH_XIAOMI
	bool "Xiaomi device"
	depends on ARCH_MSM
	help
	 Support for Xiaomi products

config XIAOMI_MSM8992
	bool "Xiaomi MSM8992"
	depends on ARCH_MSM8992
	select MACH_XIAOMI
	help
	 Support for MSM8992 Xiaomi variants

menu "Xiaomi board selection"

config XIAOMI_LIBRA
	bool "Libra board variant"
	select XIAOMI_MSM8992
	help
	 Support for Xiaomi Libra variant
	 Support for Xiaomi Libra (4C) variant

config XIAOMI_AQUA
	bool "Aqua board variant"
	select XIAOMI_MSM8992
	help
	 Support for Xiaomi Aqua (4S) variant

endmenu
```
